## Config.in
```kconfig
menu "Roki CM4 packages"
source "$BR2_EXTERNAL_ROKI_PATH/package/dinit/Config.in"
source "$BR2_EXTERNAL_ROKI_PATH/package/roki-dinit-rc/Config.in"
source "$BR2_EXTERNAL_ROKI_PATH/package/python-st7789-roki/Config.in"
source "$BR2_EXTERNAL_ROKI_PATH/package/roki-head-platform/Config.in"
source "$BR2_EXTERNAL_ROKI_PATH/package/roki-mb-interface/Config.in"
source "$BR2_EXTERNAL_ROKI_PATH/package/python-starkit/Config.in"
source "$BR2_EXTERNAL_ROKI_PATH/package/roki-rpi-firmware/Config.in"
source "$BR2_EXTERNAL_ROKI_PATH/package/roki-cm4-wifi-firmware/Config.in"
source "$BR2_EXTERNAL_ROKI_PATH/package/arducam-pivariety-sdk/Config.in"
source "$BR2_EXTERNAL_ROKI_PATH/package/libcamera-rpi/Config.in"
endmenu
```

## configs/roki_cm4_defconfig
```kconfig
BR2_aarch64=y
BR2_cortex_a72=y
BR2_ARM_FPU_VFPV4=y
BR2_TOOLCHAIN_EXTERNAL=y
BR2_TOOLCHAIN_EXTERNAL_CUSTOM=y
BR2_TOOLCHAIN_EXTERNAL_PATH="$(BR2_EXTERNAL_ROKI_PATH)/.toolchain/archlinux-aarch64"
BR2_TOOLCHAIN_EXTERNAL_CUSTOM_PREFIX="aarch64-linux-gnu"
BR2_TOOLCHAIN_EXTERNAL_HEADERS_7_0=y
BR2_TOOLCHAIN_EXTERNAL_CUSTOM_GLIBC=y
# BR2_TOOLCHAIN_EXTERNAL_INET_RPC is not set
BR2_TOOLCHAIN_EXTERNAL_CXX=y
BR2_TOOLCHAIN_EXTERNAL_OPENMP=y
BR2_TARGET_OPTIMIZATION="-O3 -march=armv8-a+crc -mtune=cortex-a72"
BR2_TARGET_LDFLAGS="-L$(STAGING_DIR)/lib -L$(STAGING_DIR)/usr/lib"
BR2_TARGET_GENERIC_HOSTNAME="roki"
BR2_TARGET_GENERIC_ROOT_PASSWD="12345"
BR2_INIT_ROKI_DINIT=y
BR2_ROOTFS_MERGED_USR=y
BR2_ROOTFS_OVERLAY="$(BR2_EXTERNAL_ROKI_PATH)/board/roki-cm4/rootfs-overlay"
BR2_ROOTFS_DEVICE_TABLE="$(BR2_EXTERNAL_ROKI_PATH)/board/roki-cm4/device_table.txt"
BR2_GENERATE_LOCALE="C.UTF-8"
BR2_WGET="$(BR2_EXTERNAL_ROKI_PATH)/scripts/wget-download.sh"
BR2_GLOBAL_PATCH_DIR="$(BR2_EXTERNAL_ROKI_PATH)/global-patches"
BR2_ROOTFS_POST_BUILD_SCRIPT="$(BR2_EXTERNAL_ROKI_PATH)/board/roki-cm4/post-build.sh"
BR2_ROOTFS_POST_IMAGE_SCRIPT="$(BR2_EXTERNAL_ROKI_PATH)/board/roki-cm4/post-image.sh"
BR2_LINUX_KERNEL=y
BR2_LINUX_KERNEL_CUSTOM_TARBALL=y
BR2_LINUX_KERNEL_CUSTOM_TARBALL_LOCATION="$(call github,raspberrypi,linux,f3ee12aca79d77b3e6708b85ca04bb1deb1f973b)/linux-f3ee12aca79d77b3e6708b85ca04bb1deb1f973b.tar.gz"
BR2_LINUX_KERNEL_PATCH="$(BR2_EXTERNAL_ROKI_PATH)/patches/linux"
BR2_LINUX_KERNEL_DEFCONFIG="bcm2711"
BR2_LINUX_KERNEL_CONFIG_FRAGMENT_FILES="$(BR2_EXTERNAL_ROKI_PATH)/board/roki-cm4/linux.fragment"
BR2_LINUX_KERNEL_DTS_SUPPORT=y
BR2_LINUX_KERNEL_CUSTOM_DTS_DIR="$(BR2_EXTERNAL_ROKI_PATH)/board/roki-cm4/dts"
BR2_LINUX_KERNEL_NEEDS_HOST_OPENSSL=y
# BR2_PACKAGE_BUSYBOX is not set
BR2_PACKAGE_ALSA_UTILS=y
BR2_PACKAGE_ALSA_UTILS_APLAY=y
BR2_PACKAGE_ALSA_UTILS_SPEAKER_TEST=y
# BR2_PACKAGE_ALSA_UTILS_ALSACTL is not set
BR2_PACKAGE_ALSA_UTILS_ALSAMIXER=y
BR2_PACKAGE_ESPEAK=y
BR2_PACKAGE_ESPEAK_AUDIO_BACKEND_ALSA=y
BR2_PACKAGE_GSTREAMER1=y
BR2_PACKAGE_GST1_PLUGINS_BASE_PLUGIN_APP=y
# BR2_PACKAGE_GST1_PLUGINS_BASE_PLUGIN_AUDIOCONVERT is not set
# BR2_PACKAGE_GST1_PLUGINS_BASE_PLUGIN_VIDEOCONVERTSCALE is not set
# BR2_PACKAGE_GST1_PLUGINS_BASE_PLUGIN_PLAYBACK is not set
# BR2_PACKAGE_GST1_PLUGINS_BASE_PLUGIN_AUDIORESAMPLE is not set
# BR2_PACKAGE_GST1_PLUGINS_BASE_PLUGIN_TYPEFIND is not set
# BR2_PACKAGE_GST1_PLUGINS_BASE_PLUGIN_VOLUME is not set
BR2_PACKAGE_GST1_PLUGINS_GOOD=y
# BR2_PACKAGE_GST1_PLUGINS_GOOD_PLUGIN_AVI is not set
# BR2_PACKAGE_GST1_PLUGINS_GOOD_PLUGIN_ISOMP4 is not set
BR2_PACKAGE_GST1_PLUGINS_GOOD_PLUGIN_RTP=y
BR2_PACKAGE_GST1_PLUGINS_GOOD_PLUGIN_UDP=y
# BR2_PACKAGE_GST1_PLUGINS_GOOD_PLUGIN_WAVPARSE is not set
BR2_PACKAGE_GST1_PLUGINS_GOOD_PLUGIN_V4L2=y
BR2_PACKAGE_GST1_PLUGINS_GOOD_PLUGIN_V4L2_PROBE=y
BR2_PACKAGE_BZIP2=y
BR2_PACKAGE_GZIP=y
BR2_PACKAGE_XZ=y
BR2_PACKAGE_ZSTD=y
BR2_PACKAGE_LSOF=y
BR2_PACKAGE_DIFFUTILS=y
BR2_PACKAGE_FINDUTILS=y
BR2_PACKAGE_GREP=y
BR2_PACKAGE_SED=y
BR2_PACKAGE_DOSFSTOOLS=y
BR2_PACKAGE_E2FSPROGS=y
BR2_PACKAGE_EVTEST=y
BR2_PACKAGE_GAWK=y
BR2_PACKAGE_I2C_TOOLS=y
BR2_PACKAGE_PCIUTILS=y
BR2_PACKAGE_RTC_TOOLS=y
BR2_PACKAGE_USBUTILS=y
BR2_PACKAGE_PYTHON3=y
BR2_PACKAGE_PYTHON3_READLINE=y
BR2_PACKAGE_PYTHON3_ZLIB=y
BR2_PACKAGE_PYTHON_EVDEV=y
BR2_PACKAGE_PYTHON_GOBJECT=y
BR2_PACKAGE_PYTHON_MSGPACK=y
BR2_PACKAGE_PYTHON_SERIAL=y
# BR2_PACKAGE_ALSA_LIB_RAWMIDI is not set
# BR2_PACKAGE_ALSA_LIB_SEQ is not set
# The board has no codec controls, DSP topology, or ALSA legacy clients.
BR2_PACKAGE_ALSA_LIB_PCM_PLUGINS="copy linear route plug rate"
BR2_PACKAGE_ALSA_LIB_CTL_PLUGINS=""
# BR2_PACKAGE_ALSA_LIB_ALOAD is not set
BR2_PACKAGE_ALSA_LIB_MIXER=y
# BR2_PACKAGE_ALSA_LIB_HWDEP is not set
# BR2_PACKAGE_ALSA_LIB_UCM is not set
# BR2_PACKAGE_ALSA_LIB_OLD_SYMBOLS is not set
# BR2_PACKAGE_ALSA_LIB_TOPOLOGY is not set
BR2_PACKAGE_NETTLE=y
BR2_PACKAGE_OPENCV4=y
BR2_PACKAGE_OPENCV4_LIB_IMGCODECS=y
BR2_PACKAGE_OPENCV4_LIB_PYTHON=y
BR2_PACKAGE_OPENCV4_WITH_JPEG=y
BR2_PACKAGE_OPENCV4_WITH_PNG=y
BR2_PACKAGE_OPENCV4_CONTRIB=y
BR2_PACKAGE_OPENCV4_CONTRIB_LIB_ARUCO=y
BR2_PACKAGE_OPENCV4_CONTRIB_LIB_XIMGPROC=y
BR2_PACKAGE_LIBGPIOD2_TOOLS=y
BR2_PACKAGE_LIBUDEV_ZERO=y
BR2_PACKAGE_LIBCURL=y
BR2_PACKAGE_LIBCURL_CURL=y
# BR2_PACKAGE_LIBCURL_COOKIES_SUPPORT is not set
# BR2_PACKAGE_LIBCURL_EXTRA_PROTOCOLS_FEATURES is not set
BR2_PACKAGE_LIBTASN1=y
BR2_PACKAGE_LIBUNISTRING=y
BR2_PACKAGE_NCURSES_WCHAR=y
BR2_PACKAGE_ETHTOOL=y
# BR2_PACKAGE_IFUPDOWN_SCRIPTS is not set
BR2_PACKAGE_IPROUTE2=y
BR2_PACKAGE_IPUTILS=y
BR2_PACKAGE_IW=y
BR2_PACKAGE_IWD=y
BR2_PACKAGE_NETCAT=y
BR2_PACKAGE_RSYNC=y
BR2_PACKAGE_OPENSSH=y
# BR2_PACKAGE_OPENSSH_CLIENT is not set
# BR2_PACKAGE_OPENSSH_KEY_UTILS is not set
# BR2_PACKAGE_OPENSSH_SANDBOX is not set
BR2_PACKAGE_FILE=y
BR2_PACKAGE_COREUTILS=y
BR2_PACKAGE_GETENT=y
BR2_PACKAGE_HTOP=y
BR2_PACKAGE_PROCPS_NG=y
BR2_PACKAGE_SHADOW=y
BR2_PACKAGE_TAR=y
BR2_PACKAGE_UTIL_LINUX_BINARIES=y
BR2_PACKAGE_UTIL_LINUX_KILL=y
BR2_PACKAGE_UTIL_LINUX_MOUNT=y
BR2_PACKAGE_UTIL_LINUX_MOUNTPOINT=y
BR2_PACKAGE_LESS=y
BR2_PACKAGE_NANO=y
BR2_TARGET_ROOTFS_EXT2=y
BR2_TARGET_ROOTFS_EXT2_4=y
BR2_TARGET_ROOTFS_EXT2_LABEL="ROOTFS"
BR2_TARGET_ROOTFS_EXT2_SIZE="320M"
# 40k inodes initially; resize2fs preserves the group density when growing to 600M.
BR2_TARGET_ROOTFS_EXT2_INODES=40960
BR2_TARGET_ROOTFS_EXT2_MKFS_OPTIONS="-b 4096 -O metadata_csum,^64bit -E lazy_itable_init=0,lazy_journal_init=0"
# BR2_TARGET_ROOTFS_TAR is not set
BR2_PACKAGE_HOST_GENIMAGE=y
BR2_PACKAGE_ROKI_DINIT_RC=y
BR2_PACKAGE_ROKI_HEAD_PLATFORM=y
BR2_PACKAGE_ROKI_MB_INTERFACE=y
BR2_PACKAGE_PYTHON_STARKIT=y
BR2_PACKAGE_ROKI_RPI_FIRMWARE=y
BR2_PACKAGE_ROKI_CM4_WIFI_FIRMWARE=y
BR2_PACKAGE_LIBCAMERA_RPI=y
```

## package/arducam-pivariety-sdk/Config.in
```kconfig
config BR2_PACKAGE_ARDUCAM_PIVARIETY_SDK
	bool "arducam-pivariety-sdk"
	depends on BR2_aarch64
	depends on BR2_INSTALL_LIBSTDCPP
	select BR2_PACKAGE_ZLIB
	help
	  Runtime library and headers supplied by Arducam for the Pivariety
	  camera bridge. The library reads the sensor tuning and control-delay
	  data stored in the bridge MCU.

comment "arducam-pivariety-sdk needs aarch64 with C++ support"
	depends on !BR2_aarch64 || !BR2_INSTALL_LIBSTDCPP
```

## package/dinit/Config.in
```kconfig
config BR2_PACKAGE_DINIT
	bool "dinit"
	depends on BR2_USE_MMU
	help
	  Dinit is a lightweight service manager and init system.

	  https://github.com/davmac314/dinit
```

## package/libcamera-rpi/Config.in
```kconfig
config BR2_PACKAGE_LIBCAMERA_RPI
	bool "libcamera-rpi"
	depends on BR2_aarch64
	depends on BR2_INSTALL_LIBSTDCPP
	depends on BR2_TOOLCHAIN_HAS_THREADS
	depends on BR2_TOOLCHAIN_GCC_AT_LEAST_10
	depends on !BR2_STATIC_LIBS
	depends on BR2_USE_WCHAR
	depends on BR2_TOOLCHAIN_HEADERS_AT_LEAST_5_3
	depends on BR2_PACKAGE_GSTREAMER1
	depends on BR2_PACKAGE_GST1_PLUGINS_BASE
	depends on BR2_PACKAGE_PYTHON3
	select BR2_PACKAGE_ARDUCAM_PIVARIETY_SDK
	select BR2_PACKAGE_LIBEVENT
	select BR2_PACKAGE_LIBYAML
	select BR2_PACKAGE_PYTHON_PYBIND
	help
	  Raspberry Pi's downstream libcamera, built only with the VC4 pipeline
	  and its IPA. Includes the experimental Python module imported as
	  'libcamera' and Arducam Pivariety support for the fitted CSI-2 camera.

comment "libcamera-rpi needs aarch64, Python, C++, threads, wchar, dynamic libraries, gcc >= 10 and headers >= 5.3"
	depends on !BR2_aarch64 || !BR2_PACKAGE_PYTHON3 || !BR2_INSTALL_LIBSTDCPP || \
		!BR2_TOOLCHAIN_HAS_THREADS || !BR2_TOOLCHAIN_GCC_AT_LEAST_10 || \
		BR2_STATIC_LIBS || !BR2_USE_WCHAR || !BR2_TOOLCHAIN_HEADERS_AT_LEAST_5_3
```

## package/python-st7789-roki/Config.in
```kconfig
config BR2_PACKAGE_PYTHON_ST7789_ROKI
	bool "python-st7789-roki"
	select BR2_PACKAGE_PYTHON_GPIOD
	select BR2_PACKAGE_PYTHON_NUMPY
	select BR2_PACKAGE_PYTHON_SPIDEV
	help
	  Pimoroni ST7789 Python driver using spidev and libgpiod.
```

## package/python-starkit/Config.in
```kconfig
config BR2_PACKAGE_PYTHON_STARKIT
	bool "python-starkit"
	depends on BR2_PACKAGE_PYTHON3
	help
	  Starkit inverse-kinematics Python extension.
```

## package/roki-cm4-wifi-firmware/Config.in
```kconfig
config BR2_PACKAGE_ROKI_CM4_WIFI_FIRMWARE
	bool "Roki CM4 built-in Wi-Fi firmware"
	depends on BR2_LINUX_KERNEL
	help
	  Downloads only the BCM43455 Wi-Fi firmware, CLM database, CM4 NVRAM
	  and wireless regulatory database needed by the built-in brcmfmac driver.
	  The files are compiled into the kernel before it is built.
```

## package/roki-dinit-rc/Config.in
```kconfig
config BR2_PACKAGE_ROKI_DINIT_RC
	bool "Roki Dinit service definitions"
	select BR2_PACKAGE_DINIT
	help
	  Roki CM4 boot sequence and service definitions for Dinit.
```

## package/roki-head-platform/Config.in
```kconfig
config BR2_PACKAGE_ROKI_HEAD_PLATFORM
	bool "Roki head platform scripts"
	select BR2_PACKAGE_PYTHON_ST7789_ROKI
	help
	  Display and button scripts used by the Roki Dinit units.

	  Select their remaining Python runtime dependencies separately: Python,
	  evdev and eSpeak NG.
```

## package/roki-mb-interface/Config.in
```kconfig
config BR2_PACKAGE_ROKI_MB_INTERFACE
	bool "roki-mb-interface"
	depends on BR2_PACKAGE_PYTHON3
	depends on BR2_INSTALL_LIBSTDCPP
	select BR2_PACKAGE_PYTHON_PYBIND
	help
	  Python binding for the Roki motherboard communication library.

	  The package downloads the pinned upstream source and its two required
	  protocol submodules as source archives without Git history.
```

## package/roki-rpi-firmware/Config.in
```kconfig
config BR2_PACKAGE_ROKI_RPI_FIRMWARE
	bool "Roki Raspberry Pi boot firmware"
	depends on BR2_aarch64
	help
	  Raspberry Pi 4 boot firmware and only the DT overlays needed by the
	  Roki CM4 head. The Linux kernel is built separately from source.
```
